## arch/arm64/configs/generic_tele_defconfig
```kconfig
CONFIG_AF_UNIX_OOB=y
CONFIG_ANDROID=y
CONFIG_ANDROID_KABI_RESERVE=y
CONFIG_ANDROID_VENDOR_HOOKS=y
CONFIG_ARCH_QCOM=y
CONFIG_ARM_PMU=y
# CONFIG_ARM_SBSA_WATCHDOG is not set
CONFIG_ARM_SCMI_CPUFREQ=y
CONFIG_ARM_SCMI_PROTOCOL=y
CONFIG_ARM_SCMI_TRANSPORT_MAILBOX=y
# CONFIG_ARM_SCMI_TRANSPORT_VIRTIO is not set
# CONFIG_ARM_SMC_WATCHDOG is not set
CONFIG_ARM_SMMU=y
CONFIG_ARM_SMMU_DISABLE_BYPASS_BY_DEFAULT=y
CONFIG_ARM_SMMU_QCOM=y
# CONFIG_ARM_SP805_WATCHDOG is not set
CONFIG_AUDIT=y
CONFIG_AUDITSYSCALL=y
CONFIG_AUDIT_COMPAT_GENERIC=y
CONFIG_AUDIT_GENERIC=y
CONFIG_BINARY_PRINTF=y
CONFIG_BLK_CGROUP=y
CONFIG_BLK_DEV_INITRD=y
CONFIG_BLK_DEV_RAM=y
CONFIG_BLK_MQ_VIRTIO=y
CONFIG_BLOCK=y
CONFIG_BPF=y
CONFIG_BPF_EVENTS=y
CONFIG_BPF_JIT=y
CONFIG_BPF_JIT_ALWAYS_ON=y
CONFIG_BPF_JIT_DEFAULT_ON=y
# CONFIG_BPF_LSM is not set
CONFIG_BPF_SYSCALL=y
CONFIG_BQL=y
CONFIG_BRIDGE=y
# CONFIG_BRIDGE_EBT_802_3 is not set
CONFIG_BRIDGE_EBT_ARP=y
CONFIG_BRIDGE_EBT_ARPREPLY=y
CONFIG_BRIDGE_EBT_BROUTE=y
CONFIG_BRIDGE_EBT_DNAT=y
CONFIG_BRIDGE_EBT_IP=y
CONFIG_BRIDGE_EBT_IP6=y
# CONFIG_BRIDGE_EBT_LIMIT is not set
CONFIG_BRIDGE_EBT_SNAT=y
# CONFIG_BRIDGE_EBT_STP is not set
CONFIG_BRIDGE_EBT_T_FILTER=y
CONFIG_BRIDGE_EBT_T_NAT=y
CONFIG_BRIDGE_NETFILTER=m
CONFIG_BRIDGE_NF_EBTABLES=y
# CONFIG_BUG_ON_HW_MEM_ONLINE_FAIL is not set
# CONFIG_CADENCE_WATCHDOG is not set
CONFIG_CGROUPS=y
CONFIG_CGROUP_BPF=y
CONFIG_CGROUP_CPUACCT=y
CONFIG_CGROUP_DEBUG=y
CONFIG_CGROUP_DEVICE=y
CONFIG_CGROUP_FREEZER=y
CONFIG_CGROUP_MISC=y
CONFIG_CGROUP_RDMA=y
CONFIG_CGROUP_SCHED=y
CONFIG_CGROUP_WRITEBACK=y
CONFIG_CMA=y
CONFIG_CMA_ALIGNMENT=8
CONFIG_CMA_AREAS=7
CONFIG_CMA_SIZE_MBYTES=16
CONFIG_CMA_SIZE_SEL_MBYTES=y
CONFIG_CMA_SYSFS=y
CONFIG_COMMON_CLK_QCOM=y
CONFIG_COMPAT=y
CONFIG_CONTEXT_SWITCH_TRACER=y
CONFIG_CONTIG_ALLOC=y
CONFIG_CPU_FREQ=y
CONFIG_CPU_FREQ_GOV_CONSERVATIVE=y
CONFIG_CPU_FREQ_GOV_POWERSAVE=y
CONFIG_CPU_FREQ_STAT=y
CONFIG_CPU_FREQ_TIMES=y
CONFIG_CPU_IDLE_GOV_MENU=y
CONFIG_CPU_RMAP=y
CONFIG_CRC16=y
CONFIG_CRYPTO=y
CONFIG_CRYPTO_ALGAPI=y
CONFIG_CRYPTO_ALGAPI2=y
CONFIG_CRYPTO_CRC32C=y
# CONFIG_CRYPTO_DEV_VIRTIO is not set
CONFIG_CRYPTO_FIPS140=y
CONFIG_CRYPTO_HASH=y
CONFIG_CRYPTO_HASH2=y
CONFIG_CRYPTO_HW=y
CONFIG_CRYPTO_LIB_POLY1305_RSIZE=9
CONFIG_CRYPTO_MANAGER_DISABLE_TESTS=y
CONFIG_DEBUG_INFO=y
CONFIG_DEBUG_KERNEL=y
# CONFIG_DEFAULT_SECURITY_DAC is not set
CONFIG_DEFAULT_SECURITY_SELINUX=y
CONFIG_DEFAULT_TCP_CONG="cubic"
CONFIG_DEVTMPFS=y
CONFIG_DEVTMPFS_MOUNT=y
CONFIG_DEV_COREDUMP=y
CONFIG_DMABUF_HEAPS=y
CONFIG_DMABUF_HEAPS_CMA=y
CONFIG_DMABUF_HEAPS_DEFERRED_FREE=y
CONFIG_DMABUF_HEAPS_PAGE_POOL=y
CONFIG_DMADEVICES=y
CONFIG_DMA_CMA=y
CONFIG_DMA_ENGINE=y
CONFIG_DMA_OF=y
CONFIG_DMA_SHARED_BUFFER=y
CONFIG_DQL=y
CONFIG_DST_CACHE=y
# CONFIG_DW_WATCHDOG is not set
CONFIG_ENERGY_MODEL=y
# CONFIG_EVM is not set
CONFIG_EXT4_FS=y
CONFIG_EXT4_USE_FOR_EXT2=y
CONFIG_FAIR_GROUP_SCHED=y
CONFIG_FAT_DEFAULT_CODEPAGE=437
CONFIG_FAT_DEFAULT_IOCHARSET="iso8859-1"
CONFIG_FAT_FS=y
CONFIG_FS_IOMAP=y
CONFIG_FS_MBCACHE=y
CONFIG_GENERIC_NET_UTILS=y
CONFIG_GPIOLIB=y
# CONFIG_GPIO_VIRTIO is not set
# CONFIG_GPIO_WATCHDOG is not set
CONFIG_GRO_CELLS=y
CONFIG_HARDENED_USERCOPY=y
CONFIG_HAVE_HW_BREAKPOINT=y
CONFIG_HIGH_RES_TIMERS=y
CONFIG_HWSPINLOCK=y
CONFIG_HWSPINLOCK_QCOM=y
CONFIG_HW_PERF_EVENTS=y
CONFIG_HW_RANDOM=y
# CONFIG_HW_RANDOM_VIRTIO is not set
CONFIG_I2C=y
CONFIG_I2C_BOARDINFO=y
CONFIG_I2C_CHARDEV=y
CONFIG_I2C_COMPAT=y
CONFIG_I2C_HELPER_AUTO=y
CONFIG_IKCONFIG=y
# CONFIG_IMA is not set
CONFIG_INET=y
CONFIG_INET6_AH=y
CONFIG_INET6_ESP=y
CONFIG_INET6_IPCOMP=y
CONFIG_INET_AH=y
CONFIG_INET_DIAG=y
CONFIG_INET_DIAG_DESTROY=y
CONFIG_INET_ESP=y
CONFIG_INET_IPCOMP=y
CONFIG_INET_TCP_DIAG=y
CONFIG_INET_TUNNEL=y
CONFIG_INET_UDP_DIAG=y
CONFIG_INTEGRITY=y
CONFIG_INTEGRITY_AUDIT=y
# CONFIG_INTEGRITY_SIGNATURE is not set
CONFIG_INTERCONNECT=y
CONFIG_INTERCONNECT_QCOM=y
CONFIG_IOMMU_IO_PGTABLE=y
CONFIG_IOMMU_IO_PGTABLE_LPAE=y
CONFIG_IP6_NF_FILTER=y
CONFIG_IP6_NF_IPTABLES=y
CONFIG_IP6_NF_MANGLE=y
CONFIG_IP6_NF_MATCH_AH=y
CONFIG_IP6_NF_MATCH_FRAG=y
CONFIG_IP6_NF_MATCH_HL=y
CONFIG_IP6_NF_MATCH_IPV6HEADER=y
CONFIG_IP6_NF_MATCH_MH=y
CONFIG_IP6_NF_MATCH_OPTS=y
CONFIG_IP6_NF_MATCH_RPFILTER=y
CONFIG_IP6_NF_MATCH_RT=y
CONFIG_IP6_NF_RAW=y
# CONFIG_IP6_NF_SECURITY is not set
CONFIG_IP6_NF_TARGET_REJECT=y
CONFIG_IPV6=y
CONFIG_IPV6_MIP6=y
CONFIG_IPV6_MROUTE=y
CONFIG_IPV6_MROUTE_MULTIPLE_TABLES=y
CONFIG_IPV6_MULTIPLE_TABLES=y
CONFIG_IPV6_NDISC_NODETYPE=y
CONFIG_IPV6_OPTIMISTIC_DAD=y
CONFIG_IPV6_ROUTER_PREF=y
CONFIG_IPV6_ROUTE_INFO=y
CONFIG_IPV6_SIT=y
CONFIG_IPV6_SUBTREES=y
CONFIG_IPV6_VTI=y
CONFIG_IP_ADVANCED_ROUTER=y
CONFIG_IP_MROUTE=y
CONFIG_IP_MROUTE_MULTIPLE_TABLES=y
CONFIG_IP_MULTICAST=y
CONFIG_IP_MULTIPLE_TABLES=y
CONFIG_IP_NF_ARPFILTER=y
CONFIG_IP_NF_ARPTABLES=y
CONFIG_IP_NF_ARP_MANGLE=y
CONFIG_IP_NF_FILTER=y
CONFIG_IP_NF_IPTABLES=y
CONFIG_IP_NF_MANGLE=y
CONFIG_IP_NF_MATCH_AH=y
CONFIG_IP_NF_MATCH_RPFILTER=y
CONFIG_IP_NF_MATCH_TTL=y
CONFIG_IP_NF_NAT=y
CONFIG_IP_NF_RAW=y
# CONFIG_IP_NF_SECURITY is not set
CONFIG_IP_NF_TARGET_MASQUERADE=y
CONFIG_IP_NF_TARGET_NETMAP=y
CONFIG_IP_NF_TARGET_REDIRECT=y
CONFIG_IP_NF_TARGET_REJECT=y
CONFIG_IP_NF_TARGET_TTL=y
CONFIG_IP_SET=y
CONFIG_JBD2=y
CONFIG_L2TP=y
CONFIG_LSM_MMAP_MIN_ADDR=32768
CONFIG_MAC80211_STA_HASH_MAX_SIZE=0
CONFIG_MAGIC_SYSRQ=y
CONFIG_MAGIC_SYSRQ_DEFAULT_ENABLE=0x1
CONFIG_MAGIC_SYSRQ_SERIAL=y
CONFIG_MAGIC_SYSRQ_SERIAL_SEQUENCE=""
CONFIG_MAILBOX=y
# CONFIG_MAX63XX_WATCHDOG is not set
CONFIG_MEMCG=y
CONFIG_MEMCG_KMEM=y
CONFIG_MEMORY_HOTPLUG=y
CONFIG_MEMORY_HOTPLUG_SPARSE=y
CONFIG_MEMORY_ISOLATION=y
CONFIG_MEM_SHARE_QMI_SERVICE=y
CONFIG_MFD_SYSCON=y
CONFIG_MHP_MEMMAP_ON_MEMORY=y
CONFIG_MMC=y
CONFIG_MMC_BLOCK=y
CONFIG_MMC_BLOCK_MINORS=32
CONFIG_MMC_SDHCI=y
CONFIG_MMC_SDHCI_MSM=y
CONFIG_MMC_SDHCI_PLTFM=y
CONFIG_MODULES=y
CONFIG_MODULES_TREE_LOOKUP=y
CONFIG_MODULE_SIG=y
CONFIG_MSM_CORE_HANG_DETECT=y
CONFIG_MSM_RPM_SMD=y
CONFIG_NET=y
CONFIG_NETFILTER=y
CONFIG_NETFILTER_XTABLES=y
CONFIG_NETFILTER_XT_MATCH_ADDRTYPE=y
CONFIG_NETFILTER_XT_MATCH_CONNLABEL=y
CONFIG_NETFILTER_XT_MATCH_CONNLIMIT=y
CONFIG_NETFILTER_XT_MATCH_CONNMARK=y
CONFIG_NETFILTER_XT_MATCH_CONNTRACK=y
CONFIG_NETFILTER_XT_MATCH_IPRANGE=y
CONFIG_NETFILTER_XT_MATCH_LIMIT=y
CONFIG_NETFILTER_XT_MATCH_MULTIPORT=y
CONFIG_NETFILTER_XT_MATCH_PKTTYPE=y
CONFIG_NETFILTER_XT_MATCH_STATE=y
# CONFIG_NETFILTER_XT_TARGET_AUDIT is not set
CONFIG_NETFILTER_XT_TARGET_LOG=y
CONFIG_NETFILTER_XT_TARGET_MARK=y
CONFIG_NETFILTER_XT_TARGET_NFLOG=y
CONFIG_NETFILTER_XT_TARGET_NFQUEUE=y
CONFIG_NETFILTER_XT_TARGET_NOTRACK=y
# CONFIG_NETFILTER_XT_TARGET_SECMARK is not set
CONFIG_NETFILTER_XT_TARGET_TCPMSS=y
CONFIG_NETFILTER_XT_TARGET_TPROXY=y
CONFIG_NETFILTER_XT_TARGET_TRACE=y
# CONFIG_NETLABEL is not set
CONFIG_NETWORK_SECMARK=y
CONFIG_NET_CLS_ACT=y
CONFIG_NET_CLS_BPF=y
CONFIG_NET_CLS_U32=y
CONFIG_NET_EMATCH=y
CONFIG_NET_EMATCH_U32=y
CONFIG_NET_FLOW_LIMIT=y
CONFIG_NET_IPVTI=y
CONFIG_NET_IP_TUNNEL=y
CONFIG_NET_KEY=y
CONFIG_NET_NS=y
CONFIG_NET_RX_BUSY_POLL=y
CONFIG_NET_SCHED=y
CONFIG_NET_SCH_HTB=y
CONFIG_NET_SCH_PRIO=y
CONFIG_NET_SCH_TBF=y
CONFIG_NET_SOCK_MSG=y
CONFIG_NF_CONNTRACK=y
CONFIG_NF_CONNTRACK_EVENTS=y
CONFIG_NF_CONNTRACK_FTP=y
CONFIG_NF_CONNTRACK_IRC=y
CONFIG_NF_CONNTRACK_MARK=y
CONFIG_NF_CONNTRACK_NETBIOS_NS=y
# CONFIG_NF_CONNTRACK_SECMARK is not set
CONFIG_NF_CONNTRACK_TFTP=y
CONFIG_NF_CONNTRACK_TIMEOUT=y
CONFIG_NF_CONNTRACK_TIMESTAMP=y
CONFIG_NF_CT_NETLINK=y
CONFIG_NF_CT_NETLINK_TIMEOUT=y
CONFIG_NLATTR=y
CONFIG_NLS=y
CONFIG_NLS_CODEPAGE_437=y
CONFIG_NLS_DEFAULT="iso8859-1"
CONFIG_NLS_ISO8859_1=y
CONFIG_NOP_TRACER=y
CONFIG_OF=y
CONFIG_PACKET=y
CONFIG_PACKET_DIAG=y
CONFIG_PAGE_COUNTER=y
CONFIG_PAGE_EXTENSION=y
CONFIG_PANIC_ON_OOPS=y
CONFIG_PANIC_ON_OOPS_VALUE=1
CONFIG_PANIC_TIMEOUT=-1
CONFIG_PCI=y
CONFIG_PCIEAER=y
CONFIG_PCIEPORTBUS=y
CONFIG_PCPU_DEV_REFCNT=y
CONFIG_PERF_EVENTS=y
CONFIG_PINCTRL_MSM=y
CONFIG_PM_OPP=y
CONFIG_PM_WAKELOCKS=y
CONFIG_PM_WAKELOCKS_GC=y
CONFIG_PM_WAKELOCKS_LIMIT=100
CONFIG_POWER_RESET_QCOM_DOWNLOAD_MODE=y
CONFIG_POWER_RESET_QCOM_DOWNLOAD_MODE_DEFAULT=y
CONFIG_POWER_RESET_QCOM_REBOOT_REASON=y
CONFIG_PRINTK_CALLER=y
CONFIG_PRINTK_TIME=y
CONFIG_PROBE_EVENTS=y
CONFIG_IKCONFIG_PROC=y
CONFIG_PROC_CHILDREN=y
CONFIG_QCOM_CLK_SMD_RPM=y
CONFIG_QCOM_CPR=y
CONFIG_QCOM_DMABUF_HEAPS=y
CONFIG_QCOM_DMABUF_HEAPS_CMA=y
CONFIG_QCOM_DMABUF_HEAPS_PAGE_POOL_REFILL=y
CONFIG_QCOM_DMABUF_HEAPS_SYSTEM=y
CONFIG_QCOM_FORCE_WDOG_BITE_ON_PANIC=y
CONFIG_QCOM_GLINK=y
CONFIG_QCOM_GLINK_PKT=y
CONFIG_QCOM_IOMMU=y
CONFIG_QCOM_IOMMU_UTIL=y
CONFIG_QCOM_MDT_LOADER=y
CONFIG_QCOM_MEMORY_DUMP_V2=y
CONFIG_QCOM_MEM_BUF=y
CONFIG_QCOM_MEM_BUF_DEV=y
CONFIG_QCOM_MEM_OFFLINE=y
# CONFIG_QCOM_PANIC_ON_NOTIF_TIMEOUT is not set
CONFIG_QCOM_PIL_INFO=y
CONFIG_QCOM_Q6V5_COMMON=y
CONFIG_QCOM_Q6V5_PAS=y
CONFIG_QCOM_Q6V5_WCSS=y
CONFIG_QCOM_QMI_HELPERS=y
CONFIG_QCOM_RAMDUMP=y
CONFIG_QCOM_RMTFS_MEM=y
CONFIG_QCOM_RPMCC=y
CONFIG_QCOM_RPROC_COMMON=y
CONFIG_QCOM_RUN_QUEUE_STATS=y
CONFIG_QCOM_SECURE_BUFFER=y
CONFIG_QCOM_SMEM=y
CONFIG_QCOM_SMEM_STATE=y
CONFIG_QCOM_SMP2P=y
CONFIG_QCOM_SOCINFO=y
CONFIG_QCOM_SOC_WATCHDOG=y
CONFIG_QCOM_SPSS=y
CONFIG_QCOM_SYSMON=y
CONFIG_QCOM_WATCHDOG_BARK_TIME=11000
CONFIG_QCOM_WATCHDOG_IPI_PING=y
CONFIG_QCOM_WATCHDOG_PET_TIME=9360
CONFIG_QCOM_WATCHDOG_WAKEUP_ENABLE=y
CONFIG_QCOM_WCNSS_PIL=y
CONFIG_QCOM_WDT=y
CONFIG_QCOM_WDT_CORE=y
CONFIG_QRTR=y
CONFIG_QRTR_SMD=y
CONFIG_QRTR_WAKEUP_MS=500
CONFIG_RCU_EXPERT=y
CONFIG_RCU_FANOUT=64
CONFIG_RCU_FANOUT_LEAF=16
CONFIG_NO_HZ=y
CONFIG_RCU_FAST_NO_HZ=y
CONFIG_RCU_NOCB_CPU=y
CONFIG_REGMAP=y
CONFIG_REGMAP_MMIO=y
CONFIG_REGULATOR=y
CONFIG_REGULATOR_FIXED_VOLTAGE=y
CONFIG_REGULATOR_PROXY_CONSUMER=y
CONFIG_REGULATOR_RPM_SMD=y
CONFIG_REGULATOR_STUB=y
CONFIG_REMOTEPROC=y
CONFIG_REMOTEPROC_CDEV=y
CONFIG_RFS_ACCEL=y
CONFIG_RPMSG=y
CONFIG_RPMSG_CHAR=y
CONFIG_RPMSG_CTRL=y
CONFIG_RPMSG_QCOM_GLINK=y
CONFIG_RPMSG_QCOM_GLINK_RPM=y
CONFIG_RPMSG_QCOM_GLINK_SMEM=y
CONFIG_RPMSG_QCOM_SMD=y
CONFIG_RPROC_SSR_NOTIF_TIMEOUT=10000
CONFIG_RPROC_SYSMON_NOTIF_TIMEOUT=10000
CONFIG_RPS=y
CONFIG_SCHEDSTATS=y
# CONFIG_SCHED_CORE is not set
CONFIG_SCHED_HRTICK=y
CONFIG_SCHED_INFO=y
CONFIG_SCHED_MC=y
CONFIG_SCHED_SMT=y
CONFIG_SECCOMP_FILTER=y
CONFIG_SECURITY=y
# CONFIG_SECURITY_APPARMOR is not set
# CONFIG_SECURITY_LANDLOCK is not set
# CONFIG_SECURITY_LOADPIN is not set
# CONFIG_SECURITY_LOCKDOWN_LSM is not set
CONFIG_SECURITY_NETWORK=y
# CONFIG_SECURITY_NETWORK_XFRM is not set
# CONFIG_SECURITY_PATH is not set
# CONFIG_SECURITY_SAFESETID is not set
CONFIG_SECURITY_SELINUX=y
CONFIG_SECURITY_SELINUX_AVC_STATS=y
# CONFIG_SECURITY_SELINUX_BOOTPARAM is not set
CONFIG_SECURITY_SELINUX_CHECKREQPROT_VALUE=0
CONFIG_SECURITY_SELINUX_DEVELOP=y
# CONFIG_SECURITY_SELINUX_DISABLE is not set
CONFIG_SECURITY_SELINUX_SID2STR_CACHE_SIZE=256
CONFIG_SECURITY_SELINUX_SIDTAB_HASH_BITS=9
# CONFIG_SECURITY_SMACK is not set
# CONFIG_SECURITY_TOMOYO is not set
# CONFIG_SECURITY_YAMA is not set
# CONFIG_SENSORS_SCH5627 is not set
# CONFIG_SENSORS_SCH5636 is not set
# CONFIG_SND_HRTIMER is not set
CONFIG_SOCK_CGROUP_DATA=y
CONFIG_SOCK_RX_QUEUE_MAPPING=y
# CONFIG_SOFT_WATCHDOG is not set
CONFIG_SPI=y
CONFIG_SPI_MASTER=y
CONFIG_SPI_SPIDEV=y
# CONFIG_SWAP is not set
CONFIG_SYN_COOKIES=y
CONFIG_TASKSTATS=y
CONFIG_TASKS_RCU_GENERIC=y
CONFIG_TASKS_TRACE_RCU=y
CONFIG_TASKS_TRACE_RCU_READ_MB=y
# CONFIG_TASK_DELAY_ACCT is not set
# CONFIG_TASK_XACCT is not set
CONFIG_TCP_CONG_CUBIC=y
CONFIG_TICK_ONESHOT=y
CONFIG_TIPC=y
CONFIG_TMPFS=y
CONFIG_TRACEPOINTS=y
CONFIG_TRACE_MMIO_ACCESS=y
CONFIG_TRACING=y
CONFIG_UIO=y
CONFIG_UIO_MSM_SHAREDMEM=y
CONFIG_UNIX=y
CONFIG_UNIX_SCM=y
CONFIG_UPROBES=y
CONFIG_UPROBE_EVENTS=y
CONFIG_USB=y
CONFIG_USB_AUTOSUSPEND_DELAY=2
CONFIG_USB_COMMON=y
CONFIG_USB_CONFIGFS=y
CONFIG_USB_CONFIGFS_F_CDEV=y
CONFIG_USB_CONFIGFS_F_DIAG=y
CONFIG_USB_CONFIGFS_F_FS=y
CONFIG_USB_CONFIGFS_F_GSI=y
CONFIG_USB_CONFIGFS_F_QDSS=y
CONFIG_USB_CONFIGFS_MASS_STORAGE=y
CONFIG_USB_CONFIGFS_UEVENT=y
CONFIG_USB_DEFAULT_PERSIST=y
CONFIG_USB_DWC3=y
CONFIG_USB_DWC3_MSM=y
CONFIG_USB_F_CDEV=y
CONFIG_USB_F_DIAG=y
CONFIG_USB_F_FS=y
CONFIG_USB_F_GSI=y
CONFIG_USB_F_MASS_STORAGE=y
CONFIG_USB_F_QDSS=y
CONFIG_USB_GADGET=y
CONFIG_USB_GADGET_STORAGE_NUM_BUFFERS=2
CONFIG_USB_GADGET_VBUS_DRAW=500
CONFIG_USB_LIBCOMPOSITE=y
CONFIG_USB_MSM_SSPHY_QMP=y
CONFIG_USB_PCI=y
CONFIG_USB_PHY=y
CONFIG_VFAT_FS=y
CONFIG_VGA_ARB=y
CONFIG_VGA_ARB_MAX_GPUS=16
CONFIG_VIRTIO=y
# CONFIG_VIRTIO_BALLOON is not set
# CONFIG_VIRTIO_BLK is not set
# CONFIG_VIRTIO_INPUT is not set
# CONFIG_VIRTIO_IOMMU is not set
CONFIG_VLAN_8021Q=y
CONFIG_VSOCKETS=y
CONFIG_WANT_DEV_COREDUMP=y
CONFIG_WATCHDOG=y
CONFIG_WATCHDOG_CORE=y
CONFIG_WATCHDOG_HANDLE_BOOT_ENABLED=y
# CONFIG_WATCHDOG_HRTIMER_PRETIMEOUT is not set
# CONFIG_WATCHDOG_NOWAYOUT is not set
CONFIG_WATCHDOG_OPEN_TIMEOUT=0
# CONFIG_WATCHDOG_PRETIMEOUT_GOV is not set
# CONFIG_WATCHDOG_SYSFS is not set
CONFIG_XFRM_INTERFACE=y
CONFIG_XFRM_STATISTICS=y
CONFIG_XFRM_USER=y
# CONFIG_XILINX_WATCHDOG is not set
CONFIG_XPS=y
```

## drivers/net/pcs/Kconfig
```kconfig
# SPDX-License-Identifier: GPL-2.0-only
#
# PCS Layer Configuration
#

menu "PCS device drivers"

config PCS_XPCS
	tristate "Synopsys DesignWare XPCS controller"
	depends on MDIO_DEVICE && MDIO_BUS
	help
	  This module provides helper functions for Synopsys DesignWare XPCS
	  controllers.

config PCS_LYNX
	tristate
	help
	  This module provides helpers to phylink for managing the Lynx PCS
	  which is part of the Layerscape and QorIQ Ethernet SERDES.

config PCS_QCOM
	bool "Qualcomm Technologies, Inc. XPCS controller"
	select DWMAC_QCOM_ETHQOS
	help
	  PCS_QCOM provides the Qualcomm Technologies, Inc. XPCS driver
	  for XGMAC. It uses SerDes for SGMII, and is compatible with both
	  SGMII and USXGMII PHY interfaces. It supports SGMII-plus as well,
	  for 2.5Gbps Full Duplex mode. It's role is to support Clause 37
	  Autonegotiation and EEE for STMMAC Ethernet controllers.

endmenu
```
